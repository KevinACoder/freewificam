## components/liblinux80211/Kconfig
```kconfig
# liblinux80211: the Linux kernel API surface, the bus engines and (later) the
# mac80211/cfg80211 stack, behind explicit OS / bus / network seams.
#
# The component is selected by the image that carries it, not by a default:
# the acceptance images (network, PCIe/NVMe, eMMC, USB storage) do not link it,
# and an image that does must say which engines and which egress it wants.

menu "liblinux80211"

config LIBLINUX80211
	bool "liblinux80211 (Linux kernel API + bus engines)"
	help
	  The kernel-facing surface a Linux wireless driver/stack compiles
	  against, plus the bus engines that reach the host through the port's
	  backend seams.  It carries no OS: the OS port supplies the CMSIS-RTOS2
	  facade the bodies call.

if LIBLINUX80211

config LIBLINUX80211_PCI
	bool "PCI engine"
	help
	  The Linux PCI records and calls over the backend seam, and the DMA /
	  interrupt plumbing.  The RK3568 adapter (ports/pci-rk3568) implements
	  the seam over the board's DesignWare root complex.

config LKPI_PCIE_CSR_SNAPSHOT
	bool "PCI CSR task-context snapshot (stall diagnosis)"
	depends on LIBLINUX80211_PCI
	help
	  Compiles the AC 7260's four interrupt-status registers into a
	  task-context read for the A4 diagnostic profile.  Off in every normal
	  image: the 2026-11-12 round hung the board once on a task-context BAR0
	  read, so the read is opt-in and only the diag case calls it.

config LIBLINUX80211_SDIO
	bool "SDIO engine"
	help
	  The Linux SDIO function records and calls over the backend seam.  The
	  adapter for this board lives in the SDIO module it drives
	  (third-party/fsl_sdmmc/ports).

config LIBLINUX80211_USB
	bool "USB engine (URB layer over CherryUSB)"
	help
	  The Linux USB host API (struct usb_device/usb_interface/urb, the
	  usb_driver registry, the anchor and coherent-allocation helpers) over
	  the component's narrow backend seam.  The adapter is
	  ports/usb-rk3568: it maps the seam onto the imported CherryUSB host
	  stack and this board's USB glue, and all DMA staging comes from the
	  non-cacheable window.  The image must also carry the USB host domain
	  (tests/board/rtos/build/usb.mk), which owns the controllers.

config LIBLINUX80211_CFG80211
	bool "cfg80211 (net/wireless)"
	help
	  Links the real net/wireless translation units into the image: the
	  control plane (wiphy/regulatory/nl80211) every Linux wireless driver
	  speaks to.  This is a GPL-2.0-only subtree
	  (components/liblinux80211/stack); an artifact that selects it is a
	  GPL-2.0 link product.  A FullMAC driver (rtl8189fs, brcmfmac) needs
	  this half only.  The imported tree is compiled by the S0 inventory
	  even when this is off; this symbol is what puts it in an image.

config LIBLINUX80211_MAC80211
	bool "mac80211 (net/mac80211)"
	depends on LIBLINUX80211_CFG80211
	help
	  Links the real net/mac80211 translation units into the image: the
	  SoftMAC MLME, aggregation, rate control and the driver-ops path.  It
	  requires cfg80211.  This is a GPL-2.0-only subtree
	  (components/liblinux80211/stack); an artifact that selects it is a
	  GPL-2.0 link product.  The SoftMAC drivers (iwlwifi, rtw88, rtw89,
	  rtl8xxxu) and the hostapd/supplicant roles need this half.

config HOSTAP_AP
	bool "hostapd AP MLME (imported NXP wpa_supplicant-rtos)"
	depends on LIBLINUX80211_MAC80211
	help
	  Links the imported hostapd AP stack (third-party/hostap: src/ap, the
	  hostapd core; the NXP FreeRTOS entry and event loop; the internal
	  crypto) and this port's platform bottom (OSA over FreeRTOS, the
	  wpa_driver_ops table on the direct nl80211 surface).  This is the AP
	  role's MLME: this kernel's mac80211 has none in-kernel, and on Linux
	  the AP MLME is hostapd.  BSD-3-Clause code; the image that selects it
	  also links the GPL-2.0 mac80211 stack and is a GPL-2.0 link product.

config AP_MLME
	bool "minimal open-AP MLME (the port's own hostapd stand-in)"
	depends on LIBLINUX80211_MAC80211
	depends on !HOSTAP_AP
	help
	  Links the port's own minimal open-AP MLME (linuxkpi_ap_mlme.c and
	  the beacon template) instead of hostapd: probe/auth/assoc parsing,
	  the three responses, the station record and the controlled-port
	  open, with the real nl80211 command chain underneath.  This is the
	  AP role for a board whose flash cannot carry the imported hostapd
	  stack; the beacon template is a fixed open HT20/WMM access point's
	  IE set, so the role is a single-client open AP.  It is mutually
	  exclusive with HOSTAP_AP: one image has exactly one AP MLME, and
	  one cfg80211_rx_mgmt_ext seam (AP_MLME images link
	  ap_mlme_rx_wrap.c, hostapd images link hostap_rx_wrap.c).

config WPA_STA
	bool "wpa_supplicant STA (WPA2-PSK/CCMP)"
	depends on LIBLINUX80211_MAC80211
	depends on !HOSTAP_AP
	help
	  Links the imported NXP wpa_supplicant core as this image's STA
	  supplicant: the 2.11 core, the NXP FreeRTOS entry/event loop, this
	  port's l2_packet and STA driver table on the direct nl80211 surface.
	  This is the G2 role (the board joins an encrypted AP); the AP role is
	  HOSTAP_AP and the two are mutually exclusive.  BSD-3-Clause code; the
	  image that selects it also links the GPL-2.0 mac80211 stack and is a
	  GPL-2.0 link product.

config LIBLINUX80211_IWLWIFI
	bool "iwlwifi (AC 7260 / mvm) driver"
	depends on LIBLINUX80211_MAC80211
	help
	  Links the vendored iwlwifi core and iwlmvm op-mode (72 TUs, byte-
	  identical to the GT pin) against the same face.  The 7260 is the PCIe
	  target of this line; the driver's probe and firmware ALIVE are C3.

config LIBLINUX80211_RTW89
	bool "rtw89 (RTL8851BU / USB) driver"
	depends on LIBLINUX80211_USB
	depends on LIBLINUX80211_MAC80211
	help
	  Links the vendored rtw89 driver (24 TUs, byte-identical to the GT pin)
	  and its USB bus unit against the wireless stack.  This is a mac80211
	  driver: the stack is the MLME and the driver implements the ops.  The
	  compiled set is derived from the driver's own Makefile under
	  wireless-drivers/rtw89/driver_config.h.  The driver tree is
	  GPL-2.0 OR BSD-3-Clause; an artifact that links it with the GPL-2.0
	  mac80211 stack is a GPL-2.0 link product and also redistributes the
	  Realtek firmware image (docs/LICENSES.md).

config LIBLINUX80211_RTW88
	bool "rtw88 (RTL8821CU / USB) driver"
	depends on LIBLINUX80211_USB
	depends on LIBLINUX80211_MAC80211
	help
	  Links the vendored rtw88 driver (20 TUs, byte-identical to the GT pin)
	  and its USB bus unit against the wireless stack.  This is a mac80211
	  SoftMAC driver: the stack is the MLME and the driver implements the
	  ops (including the USB HCI and the chip's own rate/aggregation
	  control).  The compiled set is derived from the driver's own Makefile
	  under wireless-drivers/rtw88/driver_config.h.  The driver tree is
	  GPL-2.0 OR BSD-3-Clause; an artifact that links it with the GPL-2.0
	  mac80211 stack is a GPL-2.0 link product and also redistributes the
	  Realtek rtw8821c firmware image (docs/LICENSES.md).

config LIBLINUX80211_RTL8XXXU
	bool "rtl8xxxu (RTL8188EU / USB) driver"
	depends on LIBLINUX80211_USB
	depends on LIBLINUX80211_MAC80211
	help
	  Links the vendored rtl8xxxu driver (9 TUs, byte-identical to the GT
	  pin) against the wireless stack.  This is a mac80211 SoftMAC driver:
	  the stack is the MLME and the driver implements the ops over its own
	  USB HCI.  The module's fileops table names every chip it supports, so
	  all nine units are in the link closure and the chip is a run-time
	  id_table match plus its firmware image; the compiled set is derived
	  from the driver's own Makefile under
	  wireless-drivers/rtl8xxxu/driver_config.h.  The tree is GPL-2.0-only,
	  so an artifact that links it is a GPL-2.0 link product and also
	  redistributes the Realtek rtl8188eu firmware image
	  (docs/LICENSES.md).

config LIBLINUX80211_SDIO_PROBE
	bool "SDIO host probe (no vendor driver)"
	depends on LIBLINUX80211_SDIO
	help
	  Compiles the SDIO host path and the imported card service without the
	  vendor driver, for the first probe case.  The case enumerates the card
	  and reports its identity; no function driver claims it.

config LIBLINUX80211_RTL8189FS
	bool "rtl8189fs (RTL8188F / SDIO 8189FTV) vendor driver"
	depends on LIBLINUX80211_SDIO
	depends on LIBLINUX80211_CFG80211
	help
	  Links the vendored Realtek rtl8189fs vendor stack (131 TUs, byte-
	  identical to the GT pin) against the same face, plus the board's SDIO
	  host group.  This is the vendor's own MLME: cfg80211 is the control
	  plane, not mac80211.  The tree is GPL-2.0, and an artifact that links
	  it is a GPL-2.0 link product (docs/LICENSES.md).

menu "rtl8189fs vendor feature face"
	depends on LIBLINUX80211_RTL8189FS

comment "Defaults are the GT build's answers; an F429 size profile turns"
comment "these off explicitly.  The vendor source stays verbatim."

config RTL8189FS_MP
	bool "CONFIG_MP_INCLUDED (manufacturing/MP commands)"
	default y
	help
	  The vendor's production-test surface (rtw_mp.c, ioctl_mp.c, hal_mp.c,
	  phydm_mp.c and their branches).  A station/AP image never calls it;
	  turning it off removes the units from the compiled set.

config RTL8189FS_AP
	bool "CONFIG_AP_MODE (vendor AP MLME)"
	default y
	help
	  The vendor's own AP role (rtw_ap.c and the AP branches in the MLME and
	  cfg80211 paths).  A station-only image can drop it.  autoconf.h defines
	  CONFIG_AP_MODE unconditionally, so driver_config.h undefines it after
	  the vendor config is included.

config RTL8189FS_P2P
	bool "CONFIG_P2P (Wi-Fi Direct)"
	default y
	help
	  The vendor's P2P/WFD surface (rtw_p2p.c and its branches).  Same
	  post-autoconf mechanism as AP: autoconf.h defines CONFIG_P2P
	  unconditionally, driver_config.h undefines it when this is off.

config RTL8189FS_CONCURRENT
	bool "CONFIG_CONCURRENT_MODE (multi-interface)"
	default y
	help
	  The vendor's multi-interface core (rtw_mi.c and the per-port runtime
	  switch).  A single-role image does not need it.

config RTL8189FS_POWER_SAVING
	bool "CONFIG_POWER_SAVING (LPS/IPS)"
	default y
	help
	  The vendor's power-save state machines.  The bench station already
	  turns power save off through nl80211; an image that never enables it
	  can compile the LPS/IPS paths out.

config RTL8189FS_DEBUG
	bool "CONFIG_RTW_DEBUG (vendor log strings)"
	default y
	help
	  The vendor RTW_INFO/RTW_ERR/RTW_WARN/RTW_DBG macros and their format
	  strings.  This is the largest single .rodata block in the driver.
	  Off makes every level a no-op, including the attach lines the C3/C4
	  judgement uses, so only a size-only arm may turn it off until the
	  case prints the same facts itself.

config RTL8189FS_NETIF_SG
	bool "CONFIG_RTW_NETIF_SG (scatter-gather netif)"
	default y
	help
	  The vendor netif's SG transmit path.  The F429 USB/SDIO data path has
	  no SG carrier; a copy-based image can drop it.

config RTL8189FS_EFUSE_FILE
	bool "CONFIG_EFUSE_CONFIG_FILE (efuse map from a file)"
	default y
	help
	  The vendor's file-based efuse map.  The RTOS image has no filesystem
	  (the path is absent and the open fails); off removes the read path.

config RTL8189FS_LOAD_PHY_FILE
	bool "CONFIG_LOAD_PHY_PARA_FROM_FILE (PHY parameter files)"
	default y
	help
	  The vendor's PHY-parameter file loader.  The RTOS image has no
	  filesystem; off removes the read path.

config RTL8189FS_WIFI_MONITOR
	bool "CONFIG_WIFI_MONITOR"
	default n

config RTL8189FS_TDLS
	bool "CONFIG_TDLS"
	default n

config RTL8189FS_BT_COEX
	bool "CONFIG_BT_COEXIST"
	default n

config RTL8189FS_PROC_DEBUG
	bool "CONFIG_PROC_DEBUG"
	default n
	help
	  The vendor /proc surface.  The port has no filesystem; off leaves
	  rtw_proc.c as the empty #ifdef arm.

config RTL8189FS_BR_EXT
	bool "CONFIG_BR_EXT (bridge extension)"
	default n
	help
	  The GT Kbuild itself leaves this off: it calls br_fdb_find_port(),
	  which only the Linux bridge module exports.

endmenu

config LKPI_CENSUS
	bool "kernel-API census (SDIO RX probe, claim/workqueue histograms)"
	help
	  Compiles the component's observation seam: the SDIO engine's transfer,
	  claim and pump counters with their latency histograms, the receive-
	  presentation probe the vendored driver calls, the workqueue counters,
	  and the per-frame timestamps the throughput rounds turn on.  It is an
	  observation-only build: the numbers a throughput verdict is written
	  from come from the clean image, and a census image is the attribution
	  arm when the clean one is short.  Off in every delivery image.

config LKPI_SKBQ_DIAG
	bool "skb queue owner identity and chain check"
	help
	  Records, per queue, the first enqueue/dequeue caller's return
	  address and walks the chain at dump time so `qlen` and the frames
	  actually reachable can be compared.  This is the instrument that
	  names which queue a stalled receive path is holding (a mac80211
	  reorder slot, a driver's URB queue, or a queue whose counter has
	  parted from its chain) instead of inferring it from slot addresses.
	  Observation only; off in every delivery image.

config LKPI_WQ_FORCE_HIGHPRI
	bool "lift every workqueue to Realtime (diagnostic arm)"
	help
	  Diagnostic only: the default workqueue priority is Normal (24) and
	  the driver's rate-report purge window is 500 ms, so a workqueue
	  starved by tcpip (40) loses its C2H reports and the rate control
	  loses its feedback.  This arm lifts every lkpi workqueue thread to
	  Realtime to test that window.  Off in every delivery image; an
	  artifact that sets it is a perturbed arm, not a baseline.

config LKPI_WQ_TRACE
	bool "workqueue join trace (name the held work body)"
	help
	  Turns on the workqueue's existing join trace: the body a worker is
	  executing and a refused schedule are printed once per site.  Its
	  cost is a console line per unique site, not per frame.  Off in every
	  delivery image.


choice LIBLINUX80211_NET
	prompt "Network egress implementation"
	default LIBLINUX80211_NET_NONE
	help
	  The egress is replaceable by construction: the component calls the
	  weak lkpi_netdev_rx() for received frames, and an egress module
	  defines it.  lwIP is the intended one; the null implementation is the
	  reference second implementation the seam is proven with.

config LIBLINUX80211_NET_NONE
	bool "none (frames are consumed by the component)"

config LIBLINUX80211_NET_NULL
	bool "null egress (counts, frees; the seam test's second implementation)"

config LIBLINUX80211_NET_LWIP
	bool "lwIP (the wireless netif over wlan0; C6)"
	help
	  Links the lwIP stack and the two halves of the lkpinetif adapter: the
	  netdev half in the component's Linux world, the netif/ICMP half in the
	  lwIP world.  The case face is the plain-C trio in
	  include/linux80211/net.h.  An image that selects this is the C6
	  profile; the net case's wired bridges are a separate selection.

endchoice
endif

endmenu
```
