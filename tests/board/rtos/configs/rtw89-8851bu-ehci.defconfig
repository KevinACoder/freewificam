## third-party/wpa_supplicant-rtos/Kconfig
```kconfig
menu "wpa_supplicant-rtos"
    
    config MCUX_COMPONENT_middleware.wireless.wpa_supplicant.rtos
        bool "Component middleware.wireless.wpa_supplicant.rtos"
        select MCUX_COMPONENT_middleware.freertos-kernel
        select MCUX_COMPONENT_utility.debug_console
        select MCUX_COMPONENT_component.osa
        select MCUX_COMPONENT_middleware.wifi.cli
        select MCUX_COMPONENT_middleware.wifi
        select MCUX_COMPONENT_middleware.lwip
        select MCUX_COMPONENT_middleware.mbedtls

    config MCUX_COMPONENT_middleware.wireless.wpa_supplicant.rtos.hostapd
        bool "Supplicant AP Support"
        depends on MCUX_COMPONENT_middleware.wireless.wpa_supplicant.rtos
        default y
endmenu
```

## wireless-drivers/rtl8189fs/src/Kconfig
```kconfig
# SPDX-License-Identifier: GPL-2.0-only
config RTL8189FS
	tristate "Realtek 8189FS SDIO WiFi"
	depends on MMC && CFG80211 && WLAN
	help
	  This is a vendor driver for the Realtek RTL8188F (marketed as
	  RTL8189FS/RTL8189FTV) 802.11n 1T1R SDIO wireless chip.  It is a
	  full source drop from the vendor and is not the mainline driver
	  for this part; the mainline rtl8xxxu driver is USB-only and rtw88
	  does not cover this generation.

	  The firmware image is compiled into the module, so no separate
	  firmware file is needed in /lib/firmware.

	  To compile this driver as a module, choose M here; the module will
	  be called rtl8189fs.
```
