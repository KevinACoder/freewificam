## components/liblinux80211/Kconfig
```kconfig
# liblinux80211: the Linux kernel API surface, the bus engines and (later) the
# mac80211/cfg80211 stack, behind explicit OS / bus / network seams.
#
# The component is selected by the image that carries it, not by a default:
# the acceptance images (network, PCIe/NVMe, eMMC, USB storage) do not link it,
# and an image that does must say which engines and which egress it wants.

menu "liblinux80211"

config LIBLINUX80211
	bool "liblinux80211 (Linux kernel API + bus engines)"
	help
	  The kernel-facing surface a Linux wireless driver/stack compiles
	  against, plus the bus engines that reach the host through the port's
	  backend seams.  It carries no OS: the OS port supplies the CMSIS-RTOS2
	  facade the bodies call.

if LIBLINUX80211

config LIBLINUX80211_PCI
	bool "PCI engine"
	help
	  The Linux PCI records and calls over the backend seam, and the DMA /
	  interrupt plumbing.  The RK3568 adapter (ports/pci-rk3568) implements
	  the seam over the board's DesignWare root complex.

config LKPI_PCIE_CSR_SNAPSHOT
	bool "PCI CSR task-context snapshot (stall diagnosis)"
	depends on LIBLINUX80211_PCI
	help
	  Compiles the AC 7260's four interrupt-status registers into a
	  task-context read for the A4 diagnostic profile.  Off in every normal
	  image: the 2026-11-12 round hung the board once on a task-context BAR0
	  read, so the read is opt-in and only the diag case calls it.

config LIBLINUX80211_SDIO
	bool "SDIO engine"
	help
	  The Linux SDIO function records and calls over the backend seam.  The
	  adapter for this board lives in the SDIO module it drives
	  (third-party/fsl_sdmmc/ports).

config LIBLINUX80211_USB
	bool "USB engine (URB layer over CherryUSB)"
	help
	  The Linux USB host API (struct usb_device/usb_interface/urb, the
	  usb_driver registry, the anchor and coherent-allocation helpers) over
	  the component's narrow backend seam.  The adapter is
	  ports/usb-rk3568: it maps the seam onto the imported CherryUSB host
	  stack and this board's USB glue, and all DMA staging comes from the
	  non-cacheable window.  The image must also carry the USB host domain
	  (tests/board/rtos/build/usb.mk), which owns the controllers.

config LIBLINUX80211_WIRELESS
	bool "mac80211 + cfg80211 (the imported Linux wireless stack)"
	help
	  Links the real net/mac80211 and net/wireless translation units into the
	  image.  This is a GPL-2.0-only subtree (components/liblinux80211/stack):
	  an artifact that selects this symbol is a GPL-2.0 link product.  The
	  stack is compiled by the S0 inventory even when this is off; this
	  symbol is what puts it in an image, behind its own profile.

config HOSTAP_AP
	bool "hostapd AP MLME (imported NXP wpa_supplicant-rtos)"
	depends on LIBLINUX80211_WIRELESS
	help
	  Links the imported hostapd AP stack (third-party/hostap: src/ap, the
	  hostapd core; the NXP FreeRTOS entry and event loop; the internal
	  crypto) and this port's platform bottom (OSA over FreeRTOS, the
	  wpa_driver_ops table on the direct nl80211 surface).  This is the AP
	  role's MLME: this kernel's mac80211 has none in-kernel, and on Linux
	  the AP MLME is hostapd.  BSD-3-Clause code; the image that selects it
	  also links the GPL-2.0 mac80211 stack and is a GPL-2.0 link product.

config WPA_STA
	bool "wpa_supplicant STA (WPA2-PSK/CCMP)"
	depends on LIBLINUX80211_WIRELESS
	depends on !HOSTAP_AP
	help
	  Links the imported NXP wpa_supplicant core as this image's STA
	  supplicant: the 2.11 core, the NXP FreeRTOS entry/event loop, this
	  port's l2_packet and STA driver table on the direct nl80211 surface.
	  This is the G2 role (the board joins an encrypted AP); the AP role is
	  HOSTAP_AP and the two are mutually exclusive.  BSD-3-Clause code; the
	  image that selects it also links the GPL-2.0 mac80211 stack and is a
	  GPL-2.0 link product.

config LIBLINUX80211_IWLWIFI
	bool "iwlwifi (AC 7260 / mvm) driver"
	depends on LIBLINUX80211_WIRELESS
	help
	  Links the vendored iwlwifi core and iwlmvm op-mode (72 TUs, byte-
	  identical to the GT pin) against the same face.  The 7260 is the PCIe
	  target of this line; the driver's probe and firmware ALIVE are C3.

config LIBLINUX80211_RTW89
	bool "rtw89 (RTL8851BU / USB) driver"
	depends on LIBLINUX80211_USB
	depends on LIBLINUX80211_WIRELESS
	help
	  Links the vendored rtw89 driver (24 TUs, byte-identical to the GT pin)
	  and its USB bus unit against the wireless stack.  This is a mac80211
	  driver: the stack is the MLME and the driver implements the ops.  The
	  compiled set is derived from the driver's own Makefile under
	  wireless-drivers/rtw89/driver_config.h.  The driver tree is
	  GPL-2.0 OR BSD-3-Clause; an artifact that links it with the GPL-2.0
	  mac80211 stack is a GPL-2.0 link product and also redistributes the
	  Realtek firmware image (docs/LICENSES.md).

config LIBLINUX80211_RTL8189FS
	bool "rtl8189fs (RTL8188F / SDIO 8189FTV) vendor driver"
	depends on LIBLINUX80211_SDIO
	depends on LIBLINUX80211_WIRELESS
	help
	  Links the vendored Realtek rtl8189fs vendor stack (131 TUs, byte-
	  identical to the GT pin) against the same face, plus the board's SDIO
	  host group.  This is the vendor's own MLME: cfg80211 is the control
	  plane, not mac80211.  The tree is GPL-2.0, and an artifact that links
	  it is a GPL-2.0 link product (docs/LICENSES.md).

config LKPI_CENSUS
	bool "kernel-API census (SDIO RX probe, claim/workqueue histograms)"
	help
	  Compiles the component's observation seam: the SDIO engine's transfer,
	  claim and pump counters with their latency histograms, the receive-
	  presentation probe the vendored driver calls, the workqueue counters,
	  and the per-frame timestamps the throughput rounds turn on.  It is an
	  observation-only build: the numbers a throughput verdict is written
	  from come from the clean image, and a census image is the attribution
	  arm when the clean one is short.  Off in every delivery image.


choice LIBLINUX80211_NET
	prompt "Network egress implementation"
	default LIBLINUX80211_NET_NONE
	help
	  The egress is replaceable by construction: the component calls the
	  weak lkpi_netdev_rx() for received frames, and an egress module
	  defines it.  lwIP is the intended one; the null implementation is the
	  reference second implementation the seam is proven with.

config LIBLINUX80211_NET_NONE
	bool "none (frames are consumed by the component)"

config LIBLINUX80211_NET_NULL
	bool "null egress (counts, frees; the seam test's second implementation)"

config LIBLINUX80211_NET_LWIP
	bool "lwIP (the wireless netif over wlan0; C6)"
	help
	  Links the lwIP stack and the two halves of the lkpinetif adapter: the
	  netdev half in the component's Linux world, the netif/ICMP half in the
	  lwIP world.  The case face is the plain-C trio in
	  include/linux80211/net.h.  An image that selects this is the C6
	  profile; the net case's wired bridges are a separate selection.

endchoice
endif

endmenu
```

## components/linuxkpi/Kconfig
```kconfig
# linuxkpi component options.
#
# The observation switch is the one linuxkpi-side lever the old profiles
# carried; it is CFG_DEFS-only (CONFIG_LKPI_USB_OBS) in the generated
# fragment.  The WLAN_OBS switch that turns on the census lives in the
# wireless test config.

menu "linuxkpi"

config LKPI_USB_OBS
	bool "USB observation points"
	help
	  The linuxkpi USB submit/complete observation points.  It is a
	  diagnostic arm: the observation cost is part of the measured image,
	  so it is a profile decision, not a default.

config LKPI_JOIN_TRACE
	bool "join trace"
	help
	  Two lines per channel tune in the linuxkpi face (`wlan: tune begin` and
	  `wlan: tune done <MHz> rc=`), plus the driver-callback breadcrumbs the
	  join path runs through.  It answers "did the driver tune to the AP's
	  channel and with what result" from the console alone; the macro the
	  sources test is LKPI_JOIN_TRACE.

config LKPI_TXQ_AUDIT
	bool "transmit-queue engine invariant audit"
	help
	  Compares the engine's per-queue counter with the list the queue
	  actually links, at every engine exit (O(1) per call), and writes a
	  full slot dump the first few times the two disagree; it also counts
	  frames released while a queue still links them, slots reused with
	  frames still on them, and nodes left in slots whose txq is NULL.
	  This is the 2026-11-06 wedge's instrument: a boot that breaks names
	  its own first break instead of its final state.  Diagnostic arm
	  only - the comparison and the dump are part of the measured image.
	  The macro the sources test is CONFIG_LKPI_TXQ_AUDIT.

endmenu
```

## components/net80211/Kconfig
```kconfig
# net80211 component options.

menu "net80211"

config WLAN_RX_BA
	bool "RX block-ack reorder window"
	help
	  Compiles the driver's RX block-ack reorder window (wlan_rx_ba.c) and
	  emits -DCONFIG_WLAN_RX_BA=1.  The old profiles set the make variable
	  and the same -D twice (once as an assignment, once inside
	  CONFIG_LEVERS); after the migration there is one source of truth.

config WLAN_STA_AUTHZ
	bool "station ASSOC -> AUTHORIZED transition after an open join"
	default n
	help
	  Send the driver the AUTHORIZED step of mac80211's station ladder
	  after an open association, and step back down to ASSOC on teardown.
	  mac80211 runs both immediately after ASSOC on an interface without a
	  control port (net/mac80211/mlme.c, sta_info.c).  A driver acts on it:
	  iwlwifi only lets the firmware pick a transmit rate for a station at
	  AUTHORIZED (mvm/tx.c sets TX_CMD_FLG_STA_RATE there), initialises
	  the firmware rate table for the station's links and re-sends the MAC
	  context.  Below AUTHORIZED it builds the rate from
	  info->control.rates[0], which the seam fills with idx 0 - CCK
	  1 Mbit/s on 2.4 GHz.  Off by default so no other line changes
	  shape; a profile that wants the parity step sets it to y.

config WLAN_TX_BA
	bool "TX block-ack state machine (port side)"
	default y
	help
	  Compiles the port's TX block-ack state machine (wlan_tx_ba.c) and
	  emits -DCONFIG_WLAN_TX_BA=1.  Off is a diagnostic arm, not a shape:
	  ieee80211_start_tx_ba_session() answers -EOPNOTSUPP, the driver never
	  sets RTW_TXQ_AMPDU, and every frame rides a single-frame URB.  Used by
	  W-AGG-02 to separate "aggregation is wrong" from "the frame never got
	  on the air" (aggregate arm) with one variable.

config WLAN_SEAM_TX_BACKLOG_MAX
	int "seam transmit burst bound (bulk-OUT transfers outstanding, 0 = off)"
	default 0
	range 0 64
	help
	  Refuse a data frame at the seam while the USB engine already holds
	  this many bulk-OUT transfers, queue plus in flight.  The chip's own
	  transmit queue is finite; on 2026-11-04 the 8821CU stopped completing
	  any bulk-OUT with 22 outstanding and the endpoint never moved again.
	  The bridge's stash carries the refused frame, so this is backpressure.

config WLAN_SEAM_TX_MIN_SPARE
	int "skb headers the seam keeps free when it admits a TX frame"
	default 48
	range 0 160
	help
	  The transmit seam and the receive path draw from one socket-buffer
	  pool.  A driver whose transmit path accepts work faster than its
	  transport can carry it (the USB substitute queues every frame the
	  stack hands down, and the engine has one transfer in flight per
	  endpoint) grows an unbounded tx backlog, and each queued frame pins
	  a header slot.  When the pool is empty the receive path can neither
	  re-arm its bulk-in URBs nor allocate a buffer for the next frame,
	  and a bulk-in driver that retries by re-queueing its own work turns
	  the shortage into a CPU livelock - the whole machine stops, console
	  included.

	  With this set to N, a data frame is admitted only while more than N
	  header slots (static slots plus heap headers) are free, so the
	  receive path always has room.  A refused frame takes the existing
	  seam-noskb route (the bridge's one-frame stash and its deferred
	  wake), which is backpressure, not a drop.  Management frames are
	  never gated.  0 disables the gate.

endmenu
```
